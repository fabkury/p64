## firmware/main/Kconfig.projbuild
```kconfig
menu "p64"

    menu "Development seeds (never set in a release build)"

        config P64_DEV_WIFI_SSID
            string "Wi-Fi SSID seeded into NVS when none is stored"
            default ""
            help
                Development convenience: when NVS holds no Wi-Fi credentials at boot,
                these are stored as if entered in the setup portal. Leave empty in
                releases. Put real values only in the git-ignored sdkconfig.secrets
                (see sdkconfig.secrets.example).

        config P64_DEV_WIFI_PASSWORD
            string "Wi-Fi password seeded into NVS when none is stored"
            default ""

    endmenu

    menu "microSD card"

        config P64_SD_PIN_CLK
            int "SD CLK GPIO"
            default 1
        config P64_SD_PIN_CMD
            int "SD CMD GPIO"
            default 44
        config P64_SD_PIN_D0
            int "SD D0 GPIO"
            default 17

        config P64_SD_FREQ_KHZ
            int "SD bus clock (kHz)"
            range 400 40000
            default 20000
            help
                SDMMC 1-bit. The host has its own DMA; card traffic never disturbed the
                panel in the hardware tests.

    endmenu

    menu "Inputs"

        config P64_BOOT_GPIO
            int "BOOT button GPIO"
            default 0
            help
                Held for 10 s at power-on: factory reset (spec 9).

        config P64_IMU_ROTATION_SIGN
            int "Auto-rotation direction (1 or -1)"
            default 1
            range -1 1
            help
                Which way the picture's rotation grows as the gravity angle in the IMU's
                board plane grows. Depends on how the IMU is mounted; verify by turning
                the panel 90 degrees clockwise after calibrating upright: the picture
                must stay upright. Flip the sign when it turns the other way.

    endmenu

    menu "Sensors"

        config P64_I2C_SDA
            int "I2C SDA GPIO (SHTC3, IMU, RTC)"
            default 47
        config P64_I2C_SCL
            int "I2C SCL GPIO"
            default 48

    endmenu

    menu "Makapix Club"

        config P64_MAKAPIX_HOST
            string "API host"
            default "makapix.club"
            help
                Provisioning, credentials, the promoted feed and the player RPC live at
                https://<host>/api; the MQTT broker at <host>:P64_MAKAPIX_MQTT_PORT.
                "development.makapix.club" is the server team's staging environment.

        config P64_MAKAPIX_VAULT_HOST
            string "Artwork file host"
            default "vault.makapix.club"

        config P64_MAKAPIX_VAULT_TLS
            bool "Download artworks over HTTPS"
            default n
            help
                The server offers the file store over plain HTTP for players
                (docs/player/displaying-artwork.md) because the files are public and a
                TLS session costs the ESP32 tens of kilobytes of internal RAM. Downloads
                are checked against Content-Length and decoded before use either way.

        config P64_MAKAPIX_MQTT_PORT
            int "MQTT broker port"
            default 8883

    endmenu

endmenu
```
